## config/west.yml
```yaml
manifest:
  defaults:
    revision: v0.3
  remotes:
    - name: zmkfirmware
      url-base: https://github.com/zmkfirmware
    - name: petejohanson
      url-base: https://github.com/petejohanson/
    - name: caksoylar
      url-base: https://github.com/caksoylar
    - name: geeksville
      url-base: https://github.com/geeksville
    - name: onedeadkey
      url-base: https://github.com/OneDeadKey
  projects:
    - name: zmk
      remote: zmkfirmware
      import: app/west.yml
    - name: cirque-input-module
      remote: geeksville
      revision: toucan
    - name: zmk-rgbled-widget
      remote: caksoylar
      revision: v0.3
    - name: zmk-config-aekeynox
      remote: onedeadkey
      revision: 209e9b8cfa2aaa1c881f75eda6bdf118d65f7216
  self:
    path: config
```
